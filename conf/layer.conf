## conf/layer.conf
```bitbake
BBPATH ?= ""
# We have a conf and classes directory, add to BBPATH
BBPATH =. "${LAYERDIR}:"

# We have a packages directory, add to BBFILES
BBFILES += " ${LAYERDIR}/recipes-*/*/*.bb "
BBFILES += "${@bb.utils.contains('MACHINE', 'nxp-ls1028', '${LAYERDIR}/recipes-*/*/*.bbappend', '', d)}"

BBFILE_COLLECTIONS += "wr-nxp-ls1028"
BBFILE_PATTERN_wr-nxp-ls1028 := "^${LAYERDIR}/"
BBFILE_PRIORITY_wr-nxp-ls1028 = "7"

PREFERRED_PROVIDER_virtual/kernel ?= "linux-yocto"

# This should only be incremented on significant changes that will
# cause compatibility issues with other layers
LAYERVERSION_wr-nxp-ls1028 = "1"

LAYERDEPENDS_wr-nxp-ls1028 = "core wrlinux"
LAYERSERIES_COMPAT_wr-nxp-ls1028 = "thud wrl"

# We have a pre-populated downloads directory, add to PREMIRRORS
PREMIRRORS_append += " .*://.*/.* file://${LAYERDIR}/downloads/ "
```

## conf/machine/nxp-ls1028.conf
```bitbake
#@TYPE: Machine
#@NAME: nxp-ls1028
#@DESCRIPTION: Machine configuration for NXP QorIQ Layerscape 1028A SoC

DEFAULTTUNE ?= "cortexa72"
require conf/machine/include/tune-cortexa72.inc

MACHINE_FEATURES = "ext3 pci usbgadget usbhost vfat ext3 serial alsa network screen"

MACHINE_EXTRA_RRECOMMENDS += "linux-firmware-iwlwifi-8265"
MACHINE_EXTRA_RRECOMMENDS += "linux-firmware-iwlwifi-7265d"
MACHINE_EXTRA_RRECOMMENDS += "linux-firmware-ibt-12-16"
MACHINE_EXTRA_RRECOMMENDS += "linux-firmware-ibt-17"


PREFERRED_PROVIDER_virtual/xserver = "xserver-xorg"

XSERVER = "xserver-xorg \
	   xserver-xorg-extension-dri \
	   xserver-xorg-extension-dri2 \
	   xf86-input-mouse \
	   xf86-input-keyboard \
	   xf86-input-evdev \
	   xf86-video-fbdev \
	   xf86-video-armsoc \
	   xf86-video-modesetting \
	   ${@bb.utils.contains('DISTRO_FEATURES', 'opengl', 'mesa mesa-demos', '', d)} \
	   matchbox-wm"


KERNEL_IMAGETYPE = "Image"
KERNEL_DEVICETREE = "freescale/fsl-ls1028a-rdb.dtb"

SERIAL_CONSOLES ?= "115200;ttyS0"
SERIAL_CONSOLES_CHECK ?= "${SERIAL_CONSOLES}"

IMAGE_FSTYPES += "tar.bz2"

# multilib support
MULTILIBS ?= "multilib:lib32"
DEFAULTTUNE_virtclass-multilib-lib32 ?= "armv7athf-neon"
EXTRA_IMAGECMD_jffs2 = "--pad --no-cleanmarkers --eraseblock=128"

# MACHINE_EXTRA_RRECOMMENDS = " kernel-modules kernel-devicetree"
# IMAGE_FSTYPES += "tar.bz2 wic wic.bmap"
# WKS_FILE ?= "ls1028a-sdimage.wks"
# IMAGE_INSTALL_append = " kernel-devicetree kernel-image-image"
# do_image_wic[depends] += "mtools-native:do_populate_sysroot dosfstools-native:do_populate_sysroot"
# IMAGE_BOOT_FILES ?= " Image fsl-ls1028a-rdb.dtb"

# it's used by many recipes in meta-freescale
MACHINE_SOCARCH = "${TUNE_PKGARCH}"
```
